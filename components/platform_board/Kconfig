## components/platform_board/Kconfig
```kconfig
menu "P4 Console board profile"

choice P4_BOARD
    prompt "Target board"
    default P4_BOARD_ELECROW_CROWPANEL_ADVANCED_10

config P4_BOARD_ELECROW_CROWPANEL_ADVANCED_10
    bool "Elecrow CrowPanel Advanced 10.1-inch"

config P4_BOARD_OLIMEX_ESP32_P4_PC_REV_B
    bool "Olimex ESP32-P4-PC Rev.B"

config P4_BOARD_WAVESHARE_ESP32_P4_WIFI6_TOUCH_LCD_4_3
    bool "Waveshare ESP32-P4-WIFI6-Touch-LCD-4.3"

config P4_BOARD_M5STACK_TAB5
    bool "M5Stack Tab5 C145/K145"

endchoice

config PLATFORM_BOARD_TARGET_ELECROW_10_1
    bool
    default y if P4_BOARD_ELECROW_CROWPANEL_ADVANCED_10

config PLATFORM_BOARD_TARGET_WAVESHARE_4_3
    bool
    default y if P4_BOARD_WAVESHARE_ESP32_P4_WIFI6_TOUCH_LCD_4_3

config P4_WAVESHARE_H2_USB_HOST_MODE
    bool "Use Waveshare H2 as an externally powered USB host"
    default n
    depends on P4_BOARD_WAVESHARE_ESP32_P4_WIFI6_TOUCH_LCD_4_3
    help
        Select the mutually exclusive, operator-authorized H2 host test image.
        The microSD remains app-owned and USB-device MSC is unavailable in
        this image. Firmware never sources H2 VBUS; a self-powered,
        backfeed-safe external path is required before enabling this option.

config P4_WAVESHARE_H2_FORCE_FULL_SPEED_HOST
    bool "Force Waveshare H2 host root to USB full speed"
    default y
    depends on P4_WAVESHARE_H2_USB_HOST_MODE
    help
        Keep the ESP32-P4 high-speed-capable H2 controller in its documented
        full-/low-speed-only host mode. A high-speed hub then enumerates as a
        full-speed hub, allowing low/full-speed HID devices without the
        unsupported high-speed-hub transaction-translator scheduler. This
        deliberately caps H2 at 12 Mbit/s, which is ample for HID input.

config P4_WAVESHARE_H2_RUNTIME_ROLE_SWITCH
    bool "Allow the Console OS USB Drive app to switch H2 roles"
    default y
    depends on P4_WAVESHARE_H2_USB_HOST_MODE
    help
        Build both the bounded USB Host/HID services and TinyUSB device MSC,
        but install only one controller owner at a time. Console OS boots in
        controller-host mode. The explicit USB Drive app first quiesces and
        uninstalls Host/HID, unmounts microSD, and allocates MSC on demand
        before exporting it through H2. Returning to controller mode first
        uninstalls TinyUSB, frees MSC, and remounts microSD for the OS. Any
        failed transition leaves H2 quiesced instead of starting both roles.
        Firmware still never sources physical VBUS.

endmenu
```

## components/platform_display/Kconfig
```kconfig
menu "P4 platform display service"

    config PLATFORM_DISPLAY_ELECROW_10_1_CROSS_REVISION_AUTHORIZED
        bool "Authorize the reviewed Elecrow 10.1-inch display-only path"
        default n
        help
            Allows this component to operate only the MIPI-DSI bus, internal
            LDO3/LDO4, and GPIO31 backlight path documented in
            hardware/evidence/elecrow-10.1-display-path.json. This option does
            not authorize GPIO29, GPIO41, touch, storage, audio, camera,
            wireless, USB, or any other GPIO.

    config PLATFORM_DISPLAY_WAVESHARE_4_3_BUILD_ONLY
        bool "Compile the Waveshare 4.3-inch ST7701 display client"
        default n
        help
            Enables the board-specific 480x800 portrait ST7701 seam. This is
            a build-only gate and does not prove LCD FPC identity, timing, or
            panel output.

endmenu
```

## components/platform_storage/Kconfig
```kconfig
menu "P4 platform storage service"

    config PLATFORM_STORAGE_ELECROW_10_1_CROSS_REVISION_AUTHORIZED
        bool "Authorize the reviewed Elecrow 10.1-inch SDMMC path"
        default n
        help
            Allows this component to operate only SDMMC slot 0 in one-bit
            mode on GPIO43 (CLK), GPIO44 (CMD), and GPIO39 (D0), as
            documented in hardware/evidence/elecrow-10.1-storage-path.json.
            Mounting never formats the card. This option does not authorize
            D1-D7, card-detect, write-protect, display, touch, audio, camera,
            wireless, USB, or any other GPIO.

    config PLATFORM_STORAGE_WAVESHARE_4_3_AUTHORIZED
        bool "Authorize the Waveshare 4.3 SDMMC path"
        depends on PLATFORM_BOARD_TARGET_WAVESHARE_4_3
        default n
        help
            Allows this component to mount the Waveshare 4.3 microSD socket
            without formatting, using only SDMMC0 one-bit SDR on the
            documented GPIO43 (CLK), GPIO44 (CMD), and GPIO39 (D0) subset.
            D1-D3, card detect, write protect, and unrelated peripherals stay
            disabled. Enable only in the board-specific Console OS profile.

endmenu
```

## components/platform_storage_probe/Kconfig
```kconfig
menu "P4 read-only storage probe"

    config PLATFORM_STORAGE_PROBE_ELECROW_10_1_CROSS_REVISION_AUTHORIZED
        bool "Authorize the reviewed Elecrow 10.1-inch read-only SDMMC probe"
        default n
        help
            Allows this diagnostic component to operate only SDMMC slot 0 in
            one-bit SDR mode at or below 10 MHz on GPIO43 (CLK), GPIO44 (CMD),
            and GPIO39 (D0). It exposes no write operation. Its FatFs disk
            adapter rejects every write as write-protected and no format API
            is called. D1-D7, card detect, write protect, and every unrelated
            GPIO/peripheral remain unauthorized.

endmenu
```

## components/platform_tab5/Kconfig
```kconfig
menu "Tab5 battery hardware"
config P4_TAB5_CHARGER_500MA
    bool "Enable qualified 500 mA Tab5 battery charging"
    depends on P4_BOARD_M5STACK_TAB5
    default n
    help
        Enable only for a verified compatible pack and separately authorized
        charger control. Disabled by default; voltage/current telemetry remains.
endmenu

config P4_TAB5_BLE_MULTIPLAYER
    bool "Tab5 C6 Bluetooth multiplayer"
    depends on P4_BOARD_M5STACK_TAB5
    default n
    help
        Lazily enable the C6 radio only when the user selects Bluetooth.
        The build wrapper must supply the Tab5 SDIO transport overlay.
```

## components/platform_touch/Kconfig
```kconfig
menu "ESP32-P4 platform touch"
    config PLATFORM_TOUCH_ELECROW_10_1_CROSS_REVISION_AUTHORIZED
        bool "Compile the bounded Elecrow 10.1-inch GT911 touch client"
        default n
        help
            Enables only the reviewed cross-revision touch path: a borrowed
            shared I2C1 handle with a 400 kHz GT911 device, GPIO40 reset,
            GPIO42 address-latch/interrupt input, primary 0x5d then cleaned
            0x14 fallback, polling-only runtime with no ISR callback, and
            1024x600 frames with at most five contacts. This build gate does
            not authorize flashing and is not hardware verification.
endmenu
```

## components/platform_usb_host/Kconfig
```kconfig
menu "ESP32-P4 external USB host fixture gate"

config PLATFORM_USB_HOST_FIXTURE_AUTHORIZED
    bool "A reviewed powered/backfeed-safe USB host fixture is attached"
    default n
    help
        Keep this disabled until the exact CrowPanel PCB path and the external
        host fixture have review evidence. Enabling it alone is insufficient;
        every property below and a non-empty evidence ID are also required.

config PLATFORM_USB_HOST_FIXTURE_EVIDENCE_ID
    string "Fixture evidence record ID"
    default ""
    depends on PLATFORM_USB_HOST_FIXTURE_AUTHORIZED

config PLATFORM_USB_HOST_FIXTURE_EVIDENCE_SHA256
    string "SHA-256 of committed fixture evidence JSON"
    default ""
    depends on PLATFORM_USB_HOST_FIXTURE_AUTHORIZED
    help
        A repository verifier must bind this 64-digit value and the evidence ID
        to a committed, reviewed fixture record before an authorized build.

config PLATFORM_USB_HOST_FIXTURE_CURRENT_LIMIT_MA
    int "Measured VBUS current limit (mA)"
    range 100 500
    default 100
    depends on PLATFORM_USB_HOST_FIXTURE_AUTHORIZED

config PLATFORM_USB_HOST_FIXTURE_EXTERNAL_VBUS
    bool "Fixture, not CrowPanel, supplies switched 5 V VBUS"
    default n
    depends on PLATFORM_USB_HOST_FIXTURE_AUTHORIZED

config PLATFORM_USB_HOST_FIXTURE_CURRENT_LIMITED
    bool "VBUS current limiting was measured"
    default n
    depends on PLATFORM_USB_HOST_FIXTURE_AUTHORIZED

config PLATFORM_USB_HOST_FIXTURE_BACKFEED_BLOCKED
    bool "Backfeed into CrowPanel and programmer is blocked"
    default n
    depends on PLATFORM_USB_HOST_FIXTURE_AUTHORIZED

config PLATFORM_USB_HOST_FIXTURE_COMMON_GROUND
    bool "Fixture and CrowPanel have a verified common ground"
    default n
    depends on PLATFORM_USB_HOST_FIXTURE_AUTHORIZED

config PLATFORM_USB_HOST_FIXTURE_DATA_PAIR_DIRECT
    bool "D+/D- route directly without an unqualified HS hub"
    default n
    depends on PLATFORM_USB_HOST_FIXTURE_AUTHORIZED

config PLATFORM_USB_HOST_FIXTURE_SOURCE_ROLE_COMPLIANT
    bool "Receptacle advertises a standards-compliant source role"
    default n
    depends on PLATFORM_USB_HOST_FIXTURE_AUTHORIZED

config PLATFORM_USB_HOST_FIXTURE_FAULT_VISIBLE
    bool "Overcurrent/fault state is observable"
    default n
    depends on PLATFORM_USB_HOST_FIXTURE_AUTHORIZED

config PLATFORM_USB_HOST_BOARD_PATH_REVIEWED
    bool "Exact physical PCB USB data and VBUS path was reviewed"
    default n
    depends on PLATFORM_USB_HOST_FIXTURE_AUTHORIZED

config PLATFORM_USB_HOST_WAVESHARE_4_3_PATH_REVIEWED
    bool "Exact Waveshare H2 USB data/VBUS path is reviewed"
    default n
    help
        Keep disabled until the Waveshare H2 connector is bench-qualified.
        The schematic shows GPIO24/GPIO25 data, VBUS, and 5.1 kOhm CC
        pulldowns; this option does not claim that H2 can source controller
        power.

endmenu
```

## game-platform/firmware/apps/freertos_proof/sdkconfig.defaults
```kconfig
CONFIG_IDF_TARGET="esp32p4"
CONFIG_APP_REPRODUCIBLE_BUILD=y
CONFIG_APP_COMPILE_TIME_DATE=n

CONFIG_ESP32P4_SELECTS_REV_LESS_V3=y
CONFIG_ESP32P4_REV_MIN_100=y

CONFIG_ESPTOOLPY_FLASHSIZE_16MB=y
CONFIG_ESPTOOLPY_FLASHFREQ_80M=y
CONFIG_COMPILER_OPTIMIZATION_PERF=y

CONFIG_FREERTOS_HZ=1000
CONFIG_ESP_TASK_WDT_EN=y
CONFIG_ESP_TASK_WDT_INIT=y
CONFIG_ESP_TASK_WDT_PANIC=y
CONFIG_ESP_TASK_WDT_TIMEOUT_S=20
```
