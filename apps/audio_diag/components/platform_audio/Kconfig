## apps/audio_diag/components/platform_audio/Kconfig
```kconfig
menu "ESP32-P4 platform audio"
    config PLATFORM_AUDIO_ELECROW_10_1_REVIEWED_BUILD_ONLY
        bool "Compile the reviewed Elecrow 10.1-inch ES8311 speaker path"
        default n
        help
            Enables only the cross-revision V1.0-V1.2 speaker path reviewed in
            hardware/evidence/elecrow-10.1-audio-driver-path.json. This option
            is a build gate, not permission to flash or energize the speakers.
            The first hardware run still requires separate app-only review.
endmenu
```

## apps/audio_enable_diag/sdkconfig.defaults
```kconfig
CONFIG_IDF_TARGET="esp32p4"
CONFIG_APP_REPRODUCIBLE_BUILD=y
CONFIG_APP_COMPILE_TIME_DATE=n

CONFIG_ESP32P4_SELECTS_REV_LESS_V3=y
CONFIG_ESP32P4_REV_MIN_100=y

CONFIG_ESPTOOLPY_FLASHSIZE_16MB=y
CONFIG_ESPTOOLPY_FLASHFREQ_80M=y
CONFIG_ESPTOOLPY_AFTER_NORESET=y
CONFIG_COMPILER_OPTIMIZATION_SIZE=y
CONFIG_ESP_MAIN_TASK_STACK_SIZE=8192
```

## apps/dice_core2/sdkconfig.defaults
```kconfig
CONFIG_IDF_TARGET="esp32"
CONFIG_ESPTOOLPY_FLASHSIZE_16MB=y
CONFIG_ESPTOOLPY_FLASHMODE_DIO=y
CONFIG_PARTITION_TABLE_CUSTOM=y
CONFIG_PARTITION_TABLE_CUSTOM_FILENAME="partitions.csv"
CONFIG_BT_ENABLED=y
CONFIG_BT_NIMBLE_ENABLED=y
CONFIG_BT_NIMBLE_ROLE_CENTRAL=n
CONFIG_BT_NIMBLE_ROLE_PERIPHERAL=y
CONFIG_BT_NIMBLE_MAX_CONNECTIONS=1
CONFIG_BT_NIMBLE_MAX_BONDS=4
CONFIG_BT_NIMBLE_NVS_PERSIST=y
CONFIG_BT_NIMBLE_ATT_PREFERRED_MTU=128
CONFIG_ESP_MAIN_TASK_STACK_SIZE=8192
CONFIG_COMPILER_CXX_EXCEPTIONS=n
CONFIG_SPIRAM=y
CONFIG_SPIRAM_BOOT_INIT=y
CONFIG_SPIRAM_USE_MALLOC=y
CONFIG_SPIRAM_SPEED_40M=y
CONFIG_ESP_DEFAULT_CPU_FREQ_MHZ_240=y
# This image is bound to the ROM-confirmed Core2 ESP32 revision 3.1.
CONFIG_ESP32_REV_MIN_3_1=y
CONFIG_SPIRAM_CACHE_WORKAROUND=n
CONFIG_COMPILER_OPTIMIZATION_PERF=y
CONFIG_FREERTOS_HZ=1000
```

## apps/doom/components/doom_audio/Kconfig
```kconfig
menu "Doom audio integration"
    config DOOM_AUDIO_ENGINE_ADAPTER
        bool "Build the project Doom sound-effect adapter"
        default n
        help
            Builds the FEATURE_SOUND adapter, fixed 16 kHz stereo mixer, and
            platform_audio worker. This is a compile-time integration seam,
            not permission to flash or energize the speaker path.
endmenu
```

## apps/sd_format_diag/main/Kconfig.projbuild
```kconfig
menu "P4 destructive SD format diagnostic"

    config SD_FORMAT_DIAG_DESTRUCTIVE_AUTHORIZED
        bool "Compile the explicitly authorized destructive SD formatter"
        default n
        help
            Enables destructive repartitioning and FAT32 formatting only for
            the reviewed Elecrow 10.1-inch J5 microSD path: SDMMC slot 0,
            one-bit at 1 MHz, GPIO43 CLK, GPIO44 CMD, GPIO39 D0. This erases
            the inserted card. D1-D7, card detect, write protect, and every
            unrelated GPIO/peripheral remain disabled.

endmenu
```

## apps/touch_diag/sdkconfig.defaults
```kconfig
CONFIG_IDF_TARGET="esp32p4"
CONFIG_APP_REPRODUCIBLE_BUILD=y
CONFIG_APP_COMPILE_TIME_DATE=n

CONFIG_ESP32P4_SELECTS_REV_LESS_V3=y
CONFIG_ESP32P4_REV_MIN_100=y

CONFIG_ESPTOOLPY_FLASHSIZE_16MB=y
CONFIG_ESPTOOLPY_FLASHFREQ_80M=y
CONFIG_COMPILER_OPTIMIZATION_PERF=y

CONFIG_SPIRAM=y
CONFIG_SPIRAM_MODE_HEX=y
CONFIG_SPIRAM_SPEED_200M=y
CONFIG_SPIRAM_USE_CAPS_ALLOC=y

CONFIG_IDF_EXPERIMENTAL_FEATURES=y
CONFIG_PLATFORM_DISPLAY_ELECROW_10_1_CROSS_REVISION_AUTHORIZED=y

CONFIG_ESP_LCD_TOUCH_MAX_POINTS=5
CONFIG_ESP_LCD_TOUCH_MAX_BUTTONS=0
CONFIG_PLATFORM_TOUCH_ELECROW_10_1_CROSS_REVISION_AUTHORIZED=y
```

## apps/usb_host_diag/sdkconfig.defaults
```kconfig
# SPDX-License-Identifier: MIT

CONFIG_IDF_TARGET="esp32p4"
CONFIG_APP_REPRODUCIBLE_BUILD=y
CONFIG_APP_COMPILE_TIME_DATE=n

CONFIG_ESP32P4_SELECTS_REV_LESS_V3=y
CONFIG_ESP32P4_REV_MIN_100=y

CONFIG_ESPTOOLPY_FLASHSIZE_32MB=y
CONFIG_ESPTOOLPY_FLASHFREQ_80M=y
CONFIG_ESPTOOLPY_AFTER_NORESET=y
CONFIG_COMPILER_OPTIMIZATION_PERF=y
CONFIG_ESP_DEFAULT_CPU_FREQ_MHZ_360=y
CONFIG_ESP_DEFAULT_CPU_FREQ_MHZ=360

CONFIG_PARTITION_TABLE_CUSTOM=y
CONFIG_PARTITION_TABLE_CUSTOM_FILENAME="partitions-olimex.csv"
CONFIG_PARTITION_TABLE_FILENAME="partitions-olimex.csv"

CONFIG_ESP_MAIN_TASK_STACK_SIZE=4096
CONFIG_ESP_MAIN_TASK_AFFINITY_CPU0=y
CONFIG_ESP_TASK_WDT_PANIC=y
CONFIG_ESP_TASK_WDT_TIMEOUT_S=20
```

## apps/wad_provisioner/sdkconfig.defaults
```kconfig
CONFIG_IDF_TARGET="esp32p4"

CONFIG_APP_REPRODUCIBLE_BUILD=y
CONFIG_APP_COMPILE_TIME_DATE=n

CONFIG_ESP32P4_SELECTS_REV_LESS_V3=y
CONFIG_ESP32P4_REV_MIN_100=y

CONFIG_ESPTOOLPY_FLASHSIZE_16MB=y
CONFIG_ESPTOOLPY_FLASHFREQ_80M=y
CONFIG_ESPTOOLPY_AFTER_NORESET=y
CONFIG_COMPILER_OPTIMIZATION_SIZE=y

CONFIG_PARTITION_TABLE_CUSTOM=y
CONFIG_PARTITION_TABLE_CUSTOM_FILENAME="partitions.csv"
CONFIG_PARTITION_TABLE_FILENAME="partitions.csv"

CONFIG_PLATFORM_STORAGE_ELECROW_10_1_CROSS_REVISION_AUTHORIZED=y
```

## components/p4_multiplayer/Kconfig
```kconfig
menu "P4 multiplayer wired transport"

config P4_MP_DIRECT_UART
    bool "Enable a board-authorized direct UART route"
    default n
    help
        Add a dedicated 3.3 V UART route for direct console-to-console play.
        This remains disabled until the exact board profile supplies reviewed
        controller and pin values. The console UART remains the H1 relay.

config P4_MP_DIRECT_UART_NUM
    int "Direct multiplayer UART controller"
    range -1 4
    default -1
    depends on P4_MP_DIRECT_UART

config P4_MP_DIRECT_UART_TX_GPIO
    int "Direct multiplayer TX GPIO"
    range -1 54
    default -1
    depends on P4_MP_DIRECT_UART

config P4_MP_DIRECT_UART_RX_GPIO
    int "Direct multiplayer RX GPIO"
    range -1 54
    default -1
    depends on P4_MP_DIRECT_UART

config P4_MP_DIRECT_UART_BAUDRATE
    int "Direct multiplayer baud rate"
    range 9600 2000000
    default 115200
    depends on P4_MP_DIRECT_UART

config P4_MP_DIRECT_FALLBACK_DISCOVERIES
    int "Direct-only discoveries before enabling H1 relay"
    range 1 10
    default 3
    depends on P4_MP_DIRECT_UART
    help
        A valid direct frame always wins. After this many unanswered direct
        discovery packets, discovery is mirrored to H1 so the host relay can
        be used without rebuilding firmware.

endmenu
```

## components/platform_audio/Kconfig
```kconfig
menu "ESP32-P4 platform audio"
    config PLATFORM_AUDIO_ELECROW_10_1_REVIEWED_BUILD_ONLY
        bool "Compile the reviewed Elecrow factory direct-I2S candidate"
        default n
        help
            Enables only the factory-matched direct-I2S candidate for the
            connected population:
            I2S1, GPIO21/22/23, no MCLK, and active-low GPIO30 amplifier
            control. The caller/display owns already-on LDO3/LDO4. This option
            is a build gate, not proof of audible output or permission to
            flash or energize speakers.
endmenu
```

## components/platform_audio_es8311/Kconfig
```kconfig
menu "ESP32-P4 ES8311 platform audio"
    config PLATFORM_AUDIO_ES8311_ELECROW_10_1_BUILD_ONLY
        bool "Compile the reviewed Elecrow 10.1-inch ES8311 path"
        default n
        help
            Compiles only the expected ES8311-to-NS4263B speaker path. This is
            a build gate, not permission to flash or drive GPIO30 low. Runtime
            remains blocked until connected-unit population/continuity proves
            the optional NS4168 outputs are absent or isolated and address
            0x18 is observed on the shared control bus.

    config PLATFORM_AUDIO_ES8311_WAVESHARE_4_3_BUILD_ONLY
        bool "Compile the Waveshare 4.3-inch ES8311 path"
        default n
        help
            Enables the Waveshare I2S GPIO13/12/10/9 path and active-high
            GPIO53 amplifier control. This is a build-only gate; codec
            presence, speaker wiring, and acoustic output remain unverified.
endmenu
```

## components/platform_audio_factory/Kconfig
```kconfig
menu "ESP32-P4 Elecrow factory-path audio"
    config PLATFORM_AUDIO_FACTORY_ELECROW_10_1_BUILD_ONLY
        bool "Compile the reviewed Elecrow 10.1-inch factory audio initializer"
        default n
        help
            Builds the complete pinned factory hardware initializer: PDM RX
            I2S0 first at 16 kHz mono DSR_8S on GPIO24 clock (1.024 MHz) and
            GPIO26 input, followed by speaker TX I2S1 at 16 kHz PCM16 stereo
            on GPIO21/22/23 with TX MCLK unused and active-low GPIO30. GPIO24
            may fan out through board strapping toward the codec MCLK net.
            This option is a source/build gate for the exact-unit replay
            scope. It is not continuity/population proof, acoustic proof, or
            permission to flash or energize another unit's speakers.
endmenu
```
